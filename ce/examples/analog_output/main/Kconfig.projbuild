## ce/examples/analog_output/main/Kconfig.projbuild
```kconfig
menu "LexxCE: Analog output"
    config DEMO_DAC_GPIO
        int "DAC output GPIO (25 or 26)"
        range 25 26
        default 25
endmenu
```

## ce/examples/analog_pwm/main/Kconfig.projbuild
```kconfig
menu "LexxCE: Analog input and PWM"
    config DEMO_ADC_GPIO
        int "Potentiometer ADC GPIO"
        range 0 39
        default 34
    config DEMO_PWM_GPIO
        int "LED PWM GPIO"
        range 0 33
        default 2
    config DEMO_PWM_ACTIVE_LOW
        bool "LED active-low"
        default n
endmenu
```

## ce/examples/blink/main/Kconfig.projbuild
```kconfig
menu "Blink / ESP-WROOM-32"
    config BLINK_LED_GPIO
        int "Status LED GPIO"
        range 0 33
        default 2
        help
            Default: GPIO2 on common ESP-WROOM-32 development boards.
            GPIOs used by flash or UART0 are rejected at compile time.

    config BLINK_LED_ACTIVE_LOW
        bool "Status LED is active-low"
        default n
endmenu
```

## ce/examples/blink/sdkconfig.defaults
```kconfig
CONFIG_IDF_TARGET="esp32"
CONFIG_ESPTOOLPY_FLASHSIZE_4MB=y
CONFIG_PARTITION_TABLE_CUSTOM=y
CONFIG_ESP_MAIN_TASK_STACK_SIZE=4096
CONFIG_ESP_CONSOLE_UART_DEFAULT=y
CONFIG_ESP_CONSOLE_UART_BAUDRATE=115200
CONFIG_FREERTOS_HZ=1000
CONFIG_COMPILER_OPTIMIZATION_SIZE=y
# CONFIG_COMPILER_CXX_EXCEPTIONS is not set
# CONFIG_COMPILER_CXX_RTTI is not set
CONFIG_PARTITION_TABLE_CUSTOM_FILENAME="partitions.csv"
CONFIG_BLINK_LED_GPIO=2
# CONFIG_BLINK_LED_ACTIVE_LOW is not set
```

## ce/examples/button_led/main/Kconfig.projbuild
```kconfig
menu "Button / LED"
    config DEMO_BUTTON_GPIO
        int "Button GPIO (internal pull-up, switch to GND)"
        range 0 33
        default 27
    config DEMO_LED_GPIO
        int "LED GPIO (active high)"
        range 0 33
        default 2
endmenu
```

## ce/examples/i2c_sensor/main/Kconfig.projbuild
```kconfig
menu "I2C sensors"
    config DEMO_I2C_SDA
        int "SDA GPIO"
        range 0 33
        default 21
    config DEMO_I2C_SCL
        int "SCL GPIO"
        range 0 33
        default 22
endmenu
```

## ce/examples/spi_devices/main/Kconfig.projbuild
```kconfig
menu "SPI devices"
    config DEMO_SPI_SCK
        int "SCK GPIO"
        range 0 33
        default 18
    config DEMO_SPI_MOSI
        int "MOSI GPIO (-1 to disable)"
        range -1 33
        default 23
    config DEMO_SPI_MISO
        int "MISO GPIO (-1 to disable)"
        range -1 39
        default 19
    config DEMO_SPI_CS_FIRST
        int "First device CS GPIO (active low)"
        range 0 33
        default 25
    config DEMO_SPI_CS_SECOND
        int "Second device CS GPIO (active low)"
        range 0 33
        default 26
endmenu
```
