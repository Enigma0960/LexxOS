#include <lexxos/devices/display/ssd1306_display.h>

#include <algorithm>
#include <array>
#include <cstddef>

#include <lexxos/devices/display/ssd1306_types.h>

namespace {

using lexxos::devices::display::detail::Glyph;

constexpr std::uint8_t oledWidth = 128;
constexpr std::uint8_t oledHeight = 64;
constexpr std::uint8_t oledPages = oledHeight / 8;
constexpr std::uint8_t oledFontWidth = static_cast<std::uint8_t>(Glyph::columnCount);
constexpr std::uint8_t oledGlyphStep = oledFontWidth + 1;
constexpr std::uint8_t oledMaxCharsPerLine = oledWidth / oledGlyphStep;

constexpr std::array<Glyph, 59> font{
    {
     {' ', {0x00, 0x00, 0x00, 0x00, 0x00}},
     {'!', {0x00, 0x00, 0x5F, 0x00, 0x00}},
     {'"', {0x00, 0x07, 0x00, 0x07, 0x00}},
     {'#', {0x14, 0x7F, 0x14, 0x7F, 0x14}},
     {'%', {0x23, 0x13, 0x08, 0x64, 0x62}},
     {'&', {0x36, 0x49, 0x55, 0x22, 0x50}},
     {'(', {0x00, 0x1C, 0x22, 0x41, 0x00}},
     {')', {0x00, 0x41, 0x22, 0x1C, 0x00}},
     {'+', {0x08, 0x08, 0x3E, 0x08, 0x08}},
     {',', {0x00, 0x50, 0x30, 0x00, 0x00}},
     {'-', {0x08, 0x08, 0x08, 0x08, 0x08}},
     {'.', {0x00, 0x60, 0x60, 0x00, 0x00}},
     {'/', {0x20, 0x10, 0x08, 0x04, 0x02}},
     {'0', {0x3E, 0x51, 0x49, 0x45, 0x3E}},
     {'1', {0x00, 0x42, 0x7F, 0x40, 0x00}},
     {'2', {0x42, 0x61, 0x51, 0x49, 0x46}},
     {'3', {0x21, 0x41, 0x45, 0x4B, 0x31}},
     {'4', {0x18, 0x14, 0x12, 0x7F, 0x10}},
     {'5', {0x27, 0x45, 0x45, 0x45, 0x39}},
     {'6', {0x3C, 0x4A, 0x49, 0x49, 0x30}},
     {'7', {0x01, 0x71, 0x09, 0x05, 0x03}},
     {'8', {0x36, 0x49, 0x49, 0x49, 0x36}},
     {'9', {0x06, 0x49, 0x49, 0x29, 0x1E}},
     {':', {0x00, 0x36, 0x36, 0x00, 0x00}},
     {';', {0x00, 0x56, 0x36, 0x00, 0x00}},
     {'<', {0x08, 0x14, 0x22, 0x41, 0x00}},
     {'=', {0x14, 0x14, 0x14, 0x14, 0x14}},
     {'>', {0x00, 0x41, 0x22, 0x14, 0x08}},
     {'?', {0x02, 0x01, 0x51, 0x09, 0x06}},
     {'A', {0x7E, 0x11, 0x11, 0x11, 0x7E}},
     {'B', {0x7F, 0x49, 0x49, 0x49, 0x36}},
     {'C', {0x3E, 0x41, 0x41, 0x41, 0x22}},
     {'D', {0x7F, 0x41, 0x41, 0x22, 0x1C}},
     {'E', {0x7F, 0x49, 0x49, 0x49, 0x41}},
     {'F', {0x7F, 0x09, 0x09, 0x09, 0x01}},
     {'G', {0x3E, 0x41, 0x49, 0x49, 0x7A}},
     {'H', {0x7F, 0x08, 0x08, 0x08, 0x7F}},
     {'I', {0x00, 0x41, 0x7F, 0x41, 0x00}},
     {'J', {0x20, 0x40, 0x41, 0x3F, 0x01}},
     {'K', {0x7F, 0x08, 0x14, 0x22, 0x41}},
     {'L', {0x7F, 0x40, 0x40, 0x40, 0x40}},
     {'M', {0x7F, 0x02, 0x0C, 0x02, 0x7F}},
     {'N', {0x7F, 0x04, 0x08, 0x10, 0x7F}},
     {'O', {0x3E, 0x41, 0x41, 0x41, 0x3E}},
     {'P', {0x7F, 0x09, 0x09, 0x09, 0x06}},
     {'Q', {0x3E, 0x41, 0x51, 0x21, 0x5E}},
     {'R', {0x7F, 0x09, 0x19, 0x29, 0x46}},
     {'S', {0x46, 0x49, 0x49, 0x49, 0x31}},
     {'T', {0x01, 0x01, 0x7F, 0x01, 0x01}},
     {'U', {0x3F, 0x40, 0x40, 0x40, 0x3F}},
     {'V', {0x1F, 0x20, 0x40, 0x20, 0x1F}},
     {'W', {0x3F, 0x40, 0x38, 0x40, 0x3F}},
     {'X', {0x63, 0x14, 0x08, 0x14, 0x63}},
     {'Y', {0x07, 0x08, 0x70, 0x08, 0x07}},
     {'Z', {0x61, 0x51, 0x49, 0x45, 0x43}},
     {'[', {0x00, 0x7F, 0x41, 0x41, 0x00}},
     {']', {0x00, 0x41, 0x41, 0x7F, 0x00}},
     {'_', {0x40, 0x40, 0x40, 0x40, 0x40}},
     {'|', {0x00, 0x00, 0x7F, 0x00, 0x00}},
     }
};

char normalizeGlyph(char value) {
	if (value >= 'a' && value <= 'z') {
		return static_cast<char>(value - 'a' + 'A');
	}
	return value;
}

std::array<std::uint8_t, oledFontWidth> const& glyphColumns(char value) {
	char const normalized = normalizeGlyph(value);
	for (auto const& glyph : font) {
		if (glyph.value == normalized) {
			return glyph.columns;
		}
	}
	return font[0].columns;
}

} // namespace

namespace lexxos::devices {

Ssd1306TextDisplay::Ssd1306TextDisplay(I2cBus& bus, std::uint8_t address)
    : _bus(bus)
    , _address(address) {
}

bool Ssd1306TextDisplay::initialize() {
	if (!_bus.isReady()) {
		_ready = false;
		return false;
	}

	auto transaction = I2cBusTransaction{_bus};
	if (!transaction) {
		_ready = false;
		return false;
	}

	std::array<std::uint8_t, 28> initSequence{
	    0xAE,
	    0x20,
	    0x00,
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	    0xAF,
	};

	_ready = write(0x00, initSequence.data(), initSequence.size());
	if (_ready) {
		clear();
	}
	return _ready;
}

bool Ssd1306TextDisplay::isReady() const {
	return _ready;
}

void Ssd1306TextDisplay::clear() {
	if (!_ready) {
		return;
	}

	auto transaction = I2cBusTransaction{_bus};
	if (!transaction) {
		return;
	}

	std::array<std::uint8_t, oledWidth> empty{};
	for (std::uint8_t page = 0; page < oledPages; ++page) {
		setPage(page, 0);
		write(0x40, empty.data(), empty.size());
	}
}

void Ssd1306TextDisplay::writeLine(std::uint8_t line, std::string_view text) {
	if (!_ready || line >= oledPages) {
		return;
	}

	auto transaction = I2cBusTransaction{_bus};
	if (!transaction) {
		return;
	}

	std::array<std::uint8_t, oledWidth> row{};
	std::size_t column = 0;
	std::size_t const charsToWrite = std::min<std::size_t>(text.size(), oledMaxCharsPerLine);

	for (std::size_t charIndex = 0; charIndex < charsToWrite && column + oledGlyphStep <= row.size(); ++charIndex) {
		auto const& glyph = glyphColumns(text[charIndex]);
		for (std::uint8_t glyphColumn = 0; glyphColumn < oledFontWidth; ++glyphColumn) {
			row[column++] = glyph[glyphColumn];
		}
		row[column++] = 0x00;
	}

	setPage(line, 0);
	write(0x40, row.data(), row.size());
}

bool Ssd1306TextDisplay::write(std::uint8_t control, std::uint8_t const* data, std::size_t size) {
	std::array<std::uint8_t, oledWidth + 1> buffer{};
	if (size + 1 > buffer.size()) {
		return false;
	}

	buffer[0] = control;
	std::copy(data, data + size, buffer.begin() + 1);
	return _bus.write(_address, buffer.data(), size + 1);
}

bool Ssd1306TextDisplay::command(std::uint8_t command) {
	return write(0x00, &command, 1);
}

void Ssd1306TextDisplay::setPage(std::uint8_t page, std::uint8_t column) {
	command(static_cast<std::uint8_t>(0xB0 | page));
	command(static_cast<std::uint8_t>(0x00 | (column & 0x0F)));
	command(static_cast<std::uint8_t>(0x10 | ((column >> 4) & 0x0F)));
}

} // namespace lexxos::devices
